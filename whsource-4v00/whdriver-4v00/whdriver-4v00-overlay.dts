/dts-v1/;
/plugin/;

/ {
	compatible = "brcm,bcm2711", "brcm,bcm2712", "brcm,bcm2835";

	fragment@0 {
		target-path = "/";
		__overlay__ {
			winterhill_whdriver: winterhill-whdriver {
				compatible = "winterhill,whdriver-4v00";
				interrupt-parent = <&gpio>;
				interrupts = <10 2>, <20 2>;
				status = "okay";
			};
		};
	};
};
